# file: music_1.ioc
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Mcu.Family=STM32F4
Mcu.Name=STM32F407I(E-G)Hx
Mcu.Package=UFBGA176
NVIC.PriorityGroup=NVIC_PRIORITYGROUP_4
PD14.Signal=S_TIM4_CH3
PH0-OSC_IN.Mode=HSE-External-Oscillator
PH0-OSC_IN.Signal=RCC_OSC_IN
PH1-OSC_OUT.Mode=HSE-External-Oscillator
PH1-OSC_OUT.Signal=RCC_OSC_OUT
ProjectManager.HeapSize=0x200
ProjectManager.StackSize=0x400
ProjectManager.TargetToolchain=MDK-ARM V5.32
RCC.48MHZClocksFreq_Value=84000000
RCC.AHBFreq_Value=168000000
RCC.APB1CLKDivider=RCC_HCLK_DIV4
RCC.APB1Freq_Value=42000000
RCC.APB1TimFreq_Value=84000000
RCC.APB2CLKDivider=RCC_HCLK_DIV2
RCC.APB2Freq_Value=84000000
RCC.APB2TimFreq_Value=168000000
RCC.CortexFreq_Value=168000000
RCC.HCLKFreq_Value=168000000
RCC.HSE_VALUE=12000000
RCC.HSI_VALUE=16000000
RCC.LSE_VALUE=32768
RCC.PLLM=6
RCC.PLLN=168
RCC.PLLSourceVirtual=RCC_PLLSOURCE_HSE
RCC.SYSCLKFreq_VALUE=168000000
RCC.SYSCLKSource=RCC_SYSCLKSOURCE_PLLCLK
RCC.VCOOutputFreq_Value=336000000
SH.S_TIM4_CH3.0=TIM4_CH3,PWM Generation3 CH3
TIM4.Channel-PWM\ Generation3\ CH3=TIM_CHANNEL_3
TIM4.Period=20999
VP_TIM4_VS_ClockSourceINT.Mode=Internal
board=custom

// file: Core/Src/main.c
/* USER CODE BEGIN Header */
/**
  ******************************************************************************
  * @file           : main.c
  * @brief          : Main program body
  ******************************************************************************
  * @attention
  *
  * Copyright (c) 2024 STMicroelectronics.
  * All rights reserved.
  *
  * This software is licensed under terms that can be found in the LICENSE file
  * in the root directory of this software component.
  * If no LICENSE file comes with this software, it is provided AS-IS.
  *
  ******************************************************************************
  */
/* USER CODE END Header */
#include "main.h"
#include "tim.h"
#include "gpio.h"

/* USER CODE BEGIN PD */
#define MIN_BUZZER_PWM ((uint32_t)10000)
#define MAX_BUZZER_PWM ((uint32_t)20000)
#define MAX_PSC ((uint32_t)1000)
#define C3 131
#define C3s 139
#define D3 147
#define D3s 156
#define E3 165
#define F3 175
#define F3s 185
#define G3 196
#define G3s 208
#define A3 220
#define A3s 233
#define B3 247
#define C4 262
#define C4s 277
#define D4 294
#define D4s 311
#define E4 330
#define F4 349
#define F4s 370
#define G4 392
#define G4s 415
#define A4 440
#define A4s 466
#define B4 494
#define C5 523
#define C5s 554
#define D5 587
#define D5s 622
#define E5 659
#define F5 698
#define F5s 740
#define G5 784
#define G5s 831
#define A5 880
#define A5s 932
#define B5 988
#define C6 1047
/* USER CODE END PD */

/* USER CODE BEGIN PV */

//Birthday song
// /*                       Hap  py  Birth Day  to  you,  Hap py   birth day  to
//                          C4   C4   D4   C4   F4   E4   C4   C4   D4   C4   G4 */
// unsigned int notes[] = { 262, 262, 294, 262, 349, 330, 262, 262, 294, 262, 392,

// /*                       you, Hap py  Birth Day  dear  xxxx      Hap  py   birth
//                          F4   C4   C4   C5   A4   F4   E4   D4   B4b  B4b  A4 */
//                          349, 262, 262, 523, 440, 349, 330, 294, 466, 466, 440,

// /*                       day  to  you
//                          F4   G4   F4   */
//                          349, 392, 349
//                         };

// unsigned int duration[] = {1,1,2,2,2,2,1,1,2,2,2,2,1,1,2,2,2,2,2,1,1,2,2,2,2};

//Godfather
unsigned int notes[] = {
                        G3,C4,D4s,D4,C4,D4s,C4,D4,C4,G3s,A3s,G3,
                        G3,C4,D4s,D4,C4,D4s,C4,D4,C4,G3,F3s,F3,
                        F3,G3s,B3,D4,  F3,G3s,B3,C4,
                        C4,D4s,A4s,G4s,G4,A4s,G4s,G4s,G4,G4,B3,C4,
                        C5,C5,B4,A4s,  A4s,D5,C5,G4s,G4,
                        G4,A4s,G4,F4,  F4,G4s,G4,F4,G4
                        };
unsigned int duration[] = {
                          1, 1, 1, 1, 1, 1, 1, 1, 1, 1, 1, 5,
                          1, 1, 1, 1, 1, 1, 1, 1, 1, 1, 1, 5,
                          1, 1, 1, 5,    1, 1, 1, 4,
                          1, 1, 1, 1, 1, 1, 1, 1, 1, 1, 1, 5,
                          1, 1, 1, 3,  1, 2, 1, 1, 4,
                          1, 1, 1, 3,  1, 2, 1, 1, 4
                          };
/* USER CODE END PV */

void SystemClock_Config(void);

/* USER CODE BEGIN 0 */
uint32_t Frequency = 0;
uint32_t CLOCK = 10500000;
int i;

int pwm = MIN_BUZZER_PWM;
int psc = 0;

void buzzer_on(uint16_t note) {
    Frequency = CLOCK / note; // 计算定时器的重载值

    htim4.Init.Prescaler = 0; // 预分频器设置为0
    htim4.Init.Period = Frequency; // 设置定时器的重载值

    // 设置PWM的占空比为50%
    __HAL_TIM_SET_COMPARE(&htim4, TIM_CHANNEL_3, Frequency / 2);

    // 启动PWM
    HAL_TIM_PWM_Start(&htim4, TIM_CHANNEL_3);
}

void noTone(){
    __HAL_TIM_SET_COMPARE(&htim4, TIM_CHANNEL_3, 0);
    HAL_Delay(30);
}

void playSong(){
    for (i = 0; i < sizeof(notes)/sizeof(notes[0]); i++) {
        Frequency = CLOCK / notes[i]; // 计算定时器的重载值
        htim4.Instance->ARR = Frequency; // 设置定时器的重载值
        __HAL_TIM_SET_COMPARE(&htim4, TIM_CHANNEL_3, Frequency / 2);// 设置PWM的占空比为50%
        HAL_Delay(400*duration[i]);
        noTone();
    }
}

/* USER CODE END 0 */

int main(void)
{

  /* MCU Configuration--------------------------------------------------------*/

  /* Reset of all peripherals, Initializes the Flash interface and the Systick. */
  HAL_Init();

  /* Configure the system clock */
  SystemClock_Config();

  /* Initialize all configured peripherals */
  MX_GPIO_Init();
  MX_TIM4_Init();
  HAL_TIM_Base_Start(&htim4);
  HAL_TIM_PWM_Start(&htim4, TIM_CHANNEL_3);

  /* Infinite loop */
  while (1)
  {
    playSong();
  }
}

void SystemClock_Config(void)
{
  RCC_OscInitTypeDef RCC_OscInitStruct = {0};
  RCC_ClkInitTypeDef RCC_ClkInitStruct = {0};

  /** Configure the main internal regulator output voltage
  */
  __HAL_RCC_PWR_CLK_ENABLE();
  __HAL_PWR_VOLTAGESCALING_CONFIG(PWR_REGULATOR_VOLTAGE_SCALE1);

  /** Initializes the RCC Oscillators according to the specified parameters
  * in the RCC_OscInitTypeDef structure.
  */
  RCC_OscInitStruct.OscillatorType = RCC_OSCILLATORTYPE_HSE;
  RCC_OscInitStruct.HSEState = RCC_HSE_ON;
  RCC_OscInitStruct.PLL.PLLState = RCC_PLL_ON;
  RCC_OscInitStruct.PLL.PLLSource = RCC_PLLSOURCE_HSE;
  RCC_OscInitStruct.PLL.PLLM = 6;
  RCC_OscInitStruct.PLL.PLLN = 168;
  RCC_OscInitStruct.PLL.PLLP = RCC_PLLP_DIV2;
  RCC_OscInitStruct.PLL.PLLQ = 4;
  if (HAL_RCC_OscConfig(&RCC_OscInitStruct) != HAL_OK)
  {
    Error_Handler();
  }

  /** Initializes the CPU, AHB and APB buses clocks
  */
  RCC_ClkInitStruct.ClockType = RCC_CLOCKTYPE_HCLK|RCC_CLOCKTYPE_SYSCLK
                              |RCC_CLOCKTYPE_PCLK1|RCC_CLOCKTYPE_PCLK2;
  RCC_ClkInitStruct.SYSCLKSource = RCC_SYSCLKSOURCE_PLLCLK;
  RCC_ClkInitStruct.AHBCLKDivider = RCC_SYSCLK_DIV1;
  RCC_ClkInitStruct.APB1CLKDivider = RCC_HCLK_DIV4;
  RCC_ClkInitStruct.APB2CLKDivider = RCC_HCLK_DIV2;

  if (HAL_RCC_ClockConfig(&RCC_ClkInitStruct, FLASH_LATENCY_5) != HAL_OK)
  {
    Error_Handler();
  }
}

void Error_Handler(void)
{
  __disable_irq();
  while (1)
  {
  }
}
